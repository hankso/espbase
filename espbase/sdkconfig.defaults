## main/Kconfig.projbuild
```kconfig
menu "Project Config"

    choice
        prompt "Select Target ESP32 Board"
        default BASE_BOARD_DEVKIT if IDF_TARGET_ESP32
        default BASE_BOARD_S3LUAT if IDF_TARGET_ESP32S3
        if IDF_TARGET_ESP32
            config BASE_BOARD_DEVKIT
                bool "ESP32 DevKit by Espressif"
            config BASE_BOARD_PICOD4
                bool "ESP32 PicoKit by Espressif"
            config BASE_BOARD_ESPEYE
                bool "ESP32 F4R8 CAM EYE by Espressif"
                select BASE_USE_PSRAM
                select BASE_USE_CAM
            config BASE_BOARD_ATCAM
                bool "ESP32 F4R8 CAM DEV by AiThinker"
                select BASE_USE_PSRAM
                select BASE_USE_CAM
                select BASE_NO_GPIO
            config BASE_BOARD_M5TIMER
                bool "ESP32 F4R8 Timer CAM by M5STACK"
                select BASE_USE_PSRAM
                select BASE_USE_CAM
            config BASE_BOARD_WRCAM
                bool "ESP32 F4R8 CAM WROVER by Freenove"
                select BASE_USE_PSRAM
                select BASE_USE_CAM
        endif
        if IDF_TARGET_ESP32S3
            config BASE_BOARD_S3LUAT
                bool "ESP32S3 F16 CORE DEV by LuaTOS"
            config BASE_BOARD_USBOTG
                bool "ESP32S3 F8 USB OTG by Espressif"
            config BASE_BOARD_S3ECAM
                bool "ESP32S3 F16R8 CAM ETH by Waveshare"
                select BASE_USE_PSRAM
                select BASE_USE_ETH
                select BASE_USE_CAM
            config BASE_BOARD_S3WRCAM
                bool "ESP32S3 F8R8 CAM WROOM by Freenove"
                select BASE_USE_PSRAM
                select BASE_USE_CAM
            config BASE_BOARD_S3XMINI
                bool "ESP32S3 F4R2 SuperMini by NoLogo QUAD PSRAM"
                select BASE_USE_PSRAM
            config BASE_BOARD_S3NL191
                bool "ESP32S3 F16R8 LCD 1.91 by NoLogo"
                select BASE_USE_PSRAM
                select BASE_USE_SCN
            config BASE_BOARD_S3WS147
                bool "ESP32S3 F16R8 LCD 1.47 by WaveShare"
                select BASE_USE_PSRAM
                select BASE_USE_SCN
            config BASE_BOARD_S3WS169
                bool "ESP32S3 F16R8 LCD 1.69 by WaveShare"
                select BASE_USE_PSRAM
                select BASE_USE_SCN
        endif
        config BASE_BOARD_CUSTOM
            bool "Custom ESP32 Board"
    endchoice

    config BASE_NO_GPIO
        bool
        default n
        help
            Board specific flag that has no free gpio available

    config BASE_OPT_IRAM # for ESP-IDF v4 & v5
        bool
        depends on BASE_USE_WIFI && BASE_USE_BT
        select RINGBUF_PLACE_FUNCTIONS_INTO_FLASH
        select FREERTOS_PLACE_FUNCTIONS_INTO_FLASH
        default y
        help
            Minimize IRAM usage when WiFi and BT are both enabled

    config BASE_DEBUG
        bool "Enable DEBUG features and loggings"
        select PM_TRACE
        select PM_PROFILING
        select FREERTOS_USE_TRACE_FACILITY
        select FREERTOS_GENERATE_RUN_TIME_STATS
        select FREERTOS_VTASKLIST_INCLUDE_COREID
        default y

    config BASE_AUTO_ALIGN
        bool "Enable tab and space alignment in loggings"
        default y

    config BASE_USE_PSRAM
        bool "Enable PSRAM support"
        select ESP32_SPIRAM_SUPPORT if IDF_TARGET_ESP32
        select ESP32S3_SPIRAM_SUPPORT if IDF_TARGET_ESP32S3
        select BT_ALLOCATION_FROM_SPIRAM_FIRST if BASE_USE_BT
        select SPIRAM_TRY_ALLOCATE_WIFI_LWIP if BASE_USE_WIFI
        select SPIRAM_IGNORE_NOTFOUND
        select SPIRAM_XIP_FROM_PSRAM
        select SPIRAM # for ESP-IDF v5.0+
        default n

    menuconfig BASE_USE_UART
        bool "Enable UART"
        select LOG_COLORS
        default y
    if BASE_USE_UART
        config BASE_UART_NUM
            int "UART Controller number"
            range 0 2
            default 0
    endif

    menuconfig BASE_USE_LED
        bool "Enable LED"
        default y
    if BASE_USE_LED
        config BASE_LED_NUM
            int "LED number"
            range 1 256
            default 1

        choice
            prompt "Select LED driver mode"
            default BASE_LED_MODE_GPIO
            config BASE_LED_MODE_GPIO
                bool "GPIO on/off"
            config BASE_LED_MODE_LEDC
                bool "LEDC PWM signal"
            config BASE_LED_MODE_RMT
                bool "RMT addressable LED (e.g. ws2812)"
        endchoice
    endif

    menuconfig BASE_USE_ADC
        bool "Enable ADC"
        depends on !BASE_NO_GPIO
        select ADC_CAL_EFUSE_VREF_ENABLE if IDF_TARGET_ESP32
        select ADC_CAL_EFUSE_TP_ENABLE if IDF_TARGET_ESP32
        select ADC_CAL_LUT_ENABLE if IDF_TARGET_ESP32
        default y
        help
            Enable adc_xxx functions (~5KB)
    if BASE_USE_ADC
        config BASE_ADC_HALL_SENSOR
            bool "Read HALL sensor value"
            depends on IDF_TARGET_ESP32
            default y
            help
                Compatible with BASE_ADC_SINGLE and BASE_ADC_JOYSTICK

        choice
            prompt "Select ADC sensor features"
            config BASE_ADC_SINGLE
                bool "Read single channel ADC"
            config BASE_ADC_JOYSTICK
                bool "Read joystick value by ADC"
        endchoice
    endif

    config BASE_USE_DAC
        bool "Enable DAC"
        depends on !BASE_NO_GPIO && IDF_TARGET_ESP32
        default n
        help
            Enable dac_xxx functions (~3KB)

    menuconfig BASE_USE_I2C
        bool "Enable I2C"
        default y
    if BASE_USE_I2C
        config BASE_I2C_NUM
            int "I2C Bus number"
            range 0 1
            default 0

        config BASE_I2C_SPEED
            int "I2C Bus speed in Hz"
            range 1 400000
            default 100000

        config BASE_USE_I2C0
            bool "Enable I2C Bus 0" if BASE_I2C_NUM = 1
            default y if BASE_I2C_NUM = 0 || BASE_SCN_I2C_ALT

        config BASE_USE_I2C1
            bool "Enable I2C Bus 1" if BASE_I2C_NUM = 0
            default y if BASE_I2C_NUM = 1 || BASE_SCN_I2C_ALT

        config BASE_BOARD_SDA
            int
            default 26 if BASE_BOARD_ATCAM
            default 26 if BASE_BOARD_WRCAM
            default 18 if BASE_BOARD_ESPEYE
            default 25 if BASE_BOARD_M5TIMER
            default 48 if BASE_BOARD_S3ECAM
            default 4  if BASE_BOARD_S3WRCAM
            default 18 if BASE_BOARD_S3NL191
            default 11 if BASE_BOARD_S3WS169
            help
                Board PIN for I2C SDA

        config BASE_BOARD_SCL
            int
            default 27 if BASE_BOARD_ATCAM
            default 27 if BASE_BOARD_WRCAM
            default 23 if BASE_BOARD_ESPEYE
            default 23 if BASE_BOARD_M5TIMER
            default 47 if BASE_BOARD_S3ECAM
            default 5  if BASE_BOARD_S3WRCAM
            default 17 if BASE_BOARD_S3NL191
            default 10 if BASE_BOARD_S3WS169
            help
                Board PIN for I2C SCL

        config BASE_ALS_TRACK
            bool "Enable Ambient Light Sensor"
            default y
            help
                Enable als_xxx functions (~1KB)

        config BASE_VLX_SENSOR
            bool "Enable VLX distance measurement"
            default n
            help
                Enable vlx_probe function (~5KB)

        config BASE_USE_TSCN
            bool "Enable touch screen"
            default n

        config BASE_USE_MSCN
            bool "Enable multi screen"
            default n
    endif

    menuconfig BASE_USE_SPI
        bool "Enable SPI"
        default y
    if BASE_USE_SPI
        config BASE_SPI_NUM
            int "SPI Host number"
            range 2 3
            default 2
    endif

    menuconfig BASE_USE_PWM
        bool "Enable PWM"
        depends on !BASE_NO_GPIO
        default y
    if BASE_USE_PWM
        config BASE_USE_SERVO
            bool "Enable Servo control"
            default y
            help
                Enable pwm_xxx_degree functions (~2KB)

        config BASE_USE_BUZZER
            bool "Enable Buzzer output"
            default y
            help
                Enable pwm_xxx_tone functions (~1KB)
    endif

    menuconfig BASE_USE_I2S
        bool "Enable I2S"
        depends on !BASE_NO_GPIO
        default n
        help
            Enable avi_command -> audio_xxx functions (~20KB)
    if BASE_USE_I2S
        config BASE_I2S_NUM
            int "I2S Port number"
            range 0 1
            default 0

        config BASE_PDM_STEREO
            bool "I2S PDM mono or stereo"
            default n

        config BASE_PDM_SAMPLE_RATE
            int "I2S PDM sample rate"
            range 1 48000
            default 44100
    endif

    config BASE_USE_CAM
        bool "Enable Camera"
        select BASE_USE_I2C
        imply BASE_SCN_I2C_ALT
        imply BASE_USE_PSRAM
        default n
        help
            Enable avi_command -> video_xxx functions (~60KB)

    menuconfig BASE_USE_SCN
        bool "Enable Screen"
        depends on !BASE_NO_GPIO && (BASE_USE_I2C || BASE_USE_SPI)
        default n
        help
            Enable scn_xxx functions (200KB+)
    if BASE_USE_SCN
        choice
            prompt "Select Screen interface"
            default BASE_SCN_I80 if BASE_BOARD_S3NL191
            default BASE_SCN_SPI if BASE_BOARD_S3WS147
            default BASE_SCN_SPI if BASE_BOARD_S3WS169
            config BASE_SCN_I80
                bool "I80" if BASE_BOARD_S3NL191
            config BASE_SCN_SPI
                bool "SPI" if BASE_USE_SPI
            config BASE_SCN_I2C
                bool "I2C" if BASE_USE_I2C
        endchoice

        if BASE_SCN_I2C
            config BASE_SCN_I2C_ADDR
                hex "I2C Screen 7bit address"
                default 0x3C

            config BASE_SCN_I2C_ALT
                bool "I2C Screen use dedicated I2C bus"
                default n

            config BASE_SCN_I2C_SPEED
                int "I2C Screen clock speed in Hz"
                depends on BASE_SCN_I2C_ALT
                range 1 1000000
                default 400000
        endif

        if BASE_SCN_SPI
            config BASE_SCN_SPI_MODE
                hex "SPI Screen mode (CPOL | CPHA)"
                range 0x00 0x03
                default 0x00

            config BASE_SCN_SPI_SPEED
                int "SPI Screen clock speed in Hz"
                range 1 80000000
                default 20000000
        endif

        if BASE_SCN_I80
            config BASE_SCN_I80_SPEED
                int "I80 Screen clock speed in Hz"
                range 1 80000000
                default 16000000
        endif

        config BASE_SCN_HRES
            int "Screen horizontal Resolution in pixel"
            default 128 if BASE_SCN_I2C
            default 320 if BASE_SCN_SPI
            default 320 if BASE_SCN_I80

        config BASE_SCN_VRES
            int "Screen vertical resolution in pixel"
            default 64  if BASE_SCN_I2C
            default 240 if BASE_SCN_SPI
            default 170 if BASE_SCN_I80

        config BASE_SCN_PATCH_ST7789
            bool "Patch for ST7789V" if BASE_USE_SPI || BASE_SCN_I80
    endif

    menuconfig BASE_USE_BTN
        bool "Enable Button"
        depends on !BASE_NO_GPIO
        default y
    if BASE_USE_BTN
        config BASE_BTN_INPUT
            bool "Listen on Press Button"
            default y

        config BASE_BTN_GPIO0
            bool "Try to listen on GPIO0"
            default y

        config BASE_USE_KNOB
            bool "Enable Knob input"
            default n
    endif

    menuconfig BASE_USE_GEXP
        bool "Enable GPIO Expander"
        depends on !BASE_NO_GPIO && (BASE_USE_I2C || BASE_USE_SPI)
        help
            Enable gexp_xxx functions (~19KB)
    if BASE_USE_GEXP
        config BASE_GEXP_I2C
            bool "Enable GPIO Expander on I2C"
            depends on BASE_USE_I2C

        config BASE_GEXP_SPI
            bool "Enable GPIO Expander on SPI"
            depends on BASE_USE_SPI

        config BASE_GEXP_INT
            bool "Handle interrupt from expander"
            depends on BASE_GEXP_I2C || BASE_GEXP_SPI
            default y
    endif

    config BASE_USE_TPAD
        bool "Enable touch pad"
        depends on !BASE_NO_GPIO && SOC_TOUCH_SENSOR_SUPPORTED
        default y

    menuconfig BASE_USE_BT
        bool "Enable BT, BLE and Bluedroid host"
        select BT_ENABLED
        select BT_BLE_DYNAMIC_ENV_MEMORY
        select BT_BLE_42_FEATURES_SUPPORTED if IDF_TARGET_ESP32S3
        default y if IDF_TARGET_ESP32S3
        help
            Enable btmode_xxx functions (~500KB)
    if BASE_USE_BT
        config BASE_BT_HID_DEVICE
            bool "Enable BT HID device mode"
            depends on IDF_TARGET_ESP32
            select BT_CLASSIC_ENABLED
            select BT_HID_ENABLED
            select BT_HID_DEVICE_ENABLED
            default n
            help
                If this is enabled, remember to set menuconfig:
                    Bluetooth -> Bluedroid -> BTDM_CTRL_MODE_(BR_EDR_ONLY|BTDM)
        config BASE_BLE_HID_DEVICE
            bool "Enable BLE HID device mode"
            select BT_BLE_ENABLED
            default y
        config BASE_BLE_HID_HOST
            bool "Enable BLE HID host mode"
            select BT_BLE_ENABLED
            default y
    endif

    menuconfig BASE_USE_WIFI
        bool "Enable WiFi STA and AP"
        select ESP_WIFI_FTM_ENABLE if IDF_TARGET_ESP32S3
        default y
        help
            Enable wifi_xxx functions (~400KB)
    if BASE_USE_WIFI
        config BASE_USE_EASYCONNECT
            bool "Enable EasyConnect (DPP) on STA interface"
            select ESP_WIFI_DPP_SUPPORT
            default y
            help
                See Config.net.DPP_AUTO (~25KB)

        config BASE_USE_SMARTCONFIG
            bool "Enable SmartConfig (ESPTouch) on STA interface"
            default n
            help
                See Config.net.SC_AUTO (~40KB)

        config BASE_USE_WEBSERVER
            bool "Enable web server on port 80"
            select HTTPD_WS_SUPPORT
            default y
            help
                Enable server_loop_xxx functions (~40KB)

        config BASE_OTA_FETCH
            bool "Enable OTA updation from URL"
            default y if !BASE_USE_WEBSERVER
            help
                Enable ota_updation_url function (~110KB)
    endif

    menuconfig BASE_USE_ETH
        bool "Enable Ethernet"
        default n
        help
            Enable network_eth_xxx functions (~27KB)
    if BASE_USE_ETH
        choice
            prompt "Select Ethernet interface"
            config BASE_ETH_SPI
                bool "External (SPI)"
                select ETH_USE_SPI_ETHERNET
                select ETH_SPI_ETHERNET_W5500
            config BASE_ETH_EMAC
                bool "Internal"
                depends on SOC_EMAC_SUPPORTED
                select ETH_USE_ESP32_EMAC if IDF_TARGET_ESP32
        endchoice
    endif

    menuconfig BASE_USE_USB
        bool "Enable USB host and device"
        depends on IDF_TARGET_ESP32S3 && !ESP_CONSOLE_USB_CDC
        default y
        select TINYUSB
        select TINYUSB_INIT_IN_DEFAULT_TASK
        help
            Enable usbmode_xxx functions (~60KB)
    if BASE_USE_USB
        config BASE_USB_CDC_HOST
            bool "Enable USB CDC host mode"
            default y

        config BASE_USB_CDC_DEVICE
            bool "Enable USB CDC device mode"
            select TINYUSB_CDC_ENABLED
            default y
        choice
            prompt "Select USB CDC device mode features"
            depends on BASE_USB_CDC_DEVICE
            default BASE_USB_CDC_DEVICE_SERIAL
            config BASE_USB_CDC_DEVICE_SERIAL
                bool "Act as serial device"
            config BASE_USB_CDC_DEVICE_CONSOLE
                bool "Act as console device"
        endchoice

        config BASE_USB_MSC_HOST
            bool "Enable USB MSC host mode"
            default y

        config BASE_USB_MSC_DEVICE
            bool "Enable USB MSC Slave mode"
            select TINYUSB_MSC_ENABLED
            imply BASE_USE_FFS
            imply BASE_USE_SDFS
            default y

        config BASE_USB_HID_HOST
            bool "Enable USB HID host mode"
            default y

        config BASE_USB_HID_DEVICE
            bool "Enable USB HID device mode"
            select TINYUSB_HID_ENABLED
            default y
        config BASE_USB_HID_DEVICE_TASK
            bool "Create a task for HID reports"
            depends on BASE_USB_HID_DEVICE
            default n

        config BASE_USB_NCM_DEVICE
            bool "Enable USB NCM device mode"
            default y
    endif

    menuconfig BASE_USE_FFS
        bool "Enable Flash FileSystem"
        default y
        help
            Enable FILESYS_FLASH (~30KB)
    if BASE_USE_FFS
        config BASE_FFS_MP
            string "Flash FileSystem Mount Point"
            default "/flash"

        config BASE_FFS_PART
            string "Flash FileSystem partition label"
            default "storage"
            help
                Must match the partition defined in `partitions.csv`

        choice
            prompt "Select Flash FileSystem Format"
            config BASE_FFS_SPI
                bool "Storage partition is SPI Flash FileSystem (SPIFFS)"
            config BASE_FFS_FAT
                bool "Storage partition is FAT FileSystem (FATFS)"
            config BASE_FFS_LIT
                bool "Storage partition is Little FileSystem (LITFS)"
        endchoice
    endif

    menuconfig BASE_USE_SDFS
        bool "Enable SDCard FileSystem"
        default n
        help
            Enable FILESYS_SDCARD (~50KB)
    if BASE_USE_SDFS
        config BASE_SDFS_MP
            string "SDCard FileSystem Mount Point"
            default "/sdcard"
        choice
            prompt "Select SDCard connection type"
            default BASE_SDFS_SPI
            config BASE_SDFS_SPI
                bool "SDCard SPI (MOSI, MISO, SCLK, CS)"
                select BASE_USE_SPI
            config BASE_SDFS_MMC_1LINE
                bool "SDCard MMC 1-Line (CMD, CLK, D0)"
            config BASE_SDFS_MMC_4LINE
                bool "SDCard MMC 4-Line (CMD, CLK, D3...D0)"
        endchoice
        config BASE_SDFS_MMC
            int
            default 0 if BASE_SDFS_SPI
            default 1 if BASE_SDFS_MMC_1LINE
            default 4 if BASE_SDFS_MMC_4LINE
    endif

    config BASE_USE_ELF
        bool "Enable ELF Loader"
        depends on BASE_USE_FFS || BASE_USE_SDFS
        select ELF_LOADER
        select ELF_DYNAMIC_LOAD_SHARED_OBJECT
        default y
        help
            Enable filesys_elf_xxx functions (~7KB)

    config BASE_USE_CONSOLE
        bool "Enable REPL console service"
        default y
        help
            Enable console_xxx and commands (~110KB)

    # Config GPIO numbers

    if BASE_USE_UART
        config BASE_GPIO_UART_TXD
            int "UART TXD"
            range 0 48
            default 43 if IDF_TARGET_ESP32S3
            default 1

        config BASE_GPIO_UART_RXD
            int "UART RXD"
            range 0 48
            default 44 if IDF_TARGET_ESP32S3
            default 3
    endif

    config BASE_GPIO_LED
        int "LED pin"
        depends on BASE_USE_LED
        range 0 48
        default 5

    if BASE_USE_ADC
        config BASE_GPIO_ADC0
            int "ADC input 0"
            range 36 36 if BASE_ADC_HALL_SENSOR
            range 32 39 if IDF_TARGET_ESP32
            range 1 10 if IDF_TARGET_ESP32S3
            range 0 48
            default 1 if IDF_TARGET_ESP32S3
            default 36

        config BASE_GPIO_ADC1
            int "ADC input 1"
            depends on BASE_ADC_JOYSTICK
            range 39 39 if BASE_ADC_HALL_SENSOR
            range 32 39 if IDF_TARGET_ESP32
            range 1 10 if IDF_TARGET_ESP32S3
            range 0 48
            default 2 if IDF_TARGET_ESP32S3
            default 39
    endif

    config BASE_GPIO_DAC0
        int "DAC output 0"
        depends on BASE_USE_DAC
        range 25 26
        default 25

    if BASE_USE_I2C0
        config BASE_GPIO_I2C_SDA0
            int "I2C SDA0"
            range 0 48
            default 5 if IDF_TARGET_ESP32S3
            default 21

        config BASE_GPIO_I2C_SCL0
            int "I2C SCL0"
            range 0 48
            default 6 if IDF_TARGET_ESP32S3
            default 22
    endif

    if BASE_USE_I2C1
        config BASE_GPIO_I2C_SDA1
            int "I2C SDA1"
            range 0 48
            default 41 if IDF_TARGET_ESP32S3
            default 26

        config BASE_GPIO_I2C_SCL1
            int "I2C SCL1"
            range 0 48
            default 42 if IDF_TARGET_ESP32S3
            default 27
    endif

    if BASE_USE_SPI
        config BASE_GPIO_SPI_MISO
            int "SPI MISO"
            range 0 48
            default 13 if IDF_TARGET_ESP32S3
            default 12

        config BASE_GPIO_SPI_MOSI
            int "SPI MOSI"
            range 0 48
            default 11 if IDF_TARGET_ESP32S3
            default 13

        config BASE_GPIO_SPI_SCLK
            int "SPI SCLK"
            range 0 48
            default 12 if IDF_TARGET_ESP32S3
            default 14

        config BASE_GPIO_SPI_SDFS
            int "SPI CS for SDCard"
            depends on BASE_SDFS_SPI
            range 0 48
            default 10 if IDF_TARGET_ESP32S3
            default 15

        config BASE_GPIO_SPI_SCN
            int "SPI CS for Screen"
            depends on BASE_SCN_SPI
            range 0 48
            default 8 if IDF_TARGET_ESP32S3
            default 18

        config BASE_GPIO_SPI_GEXP
            int "SPI CS for GPIOExp"
            depends on BASE_GEXP_SPI
            range 0 48
            default 9 if IDF_TARGET_ESP32S3
            default 19
    endif

    if BASE_USE_SCN
        config BASE_GPIO_SCN_BL
            int "Screen backlight"
            range -1 48
            default -1

        config BASE_GPIO_SCN_RST
            int "Screen reset"
            range -1 48
            default -1

        config BASE_GPIO_SCN_DC
            int "Screen data/cmd" if BASE_SCN_SPI || BASE_SCN_I80
            range 0 48
            default 7 if IDF_TARGET_ESP32S3
            default 23
    endif

    if BASE_SDFS_MMC > 0 && IDF_TARGET_ESP32S3
        config BASE_GPIO_MMC_D0
            int "MMC D0"
            default 37

        if BASE_SDFS_MMC > 1
            config BASE_GPIO_MMC_D1
                int "MMC D1"
                default 38

            config BASE_GPIO_MMC_D2
                int "MMC D2"
                default 33

            config BASE_GPIO_MMC_D3
                int "MMC D3"
                default 34
        endif

        config BASE_GPIO_MMC_CLK
            int "MMC CLK"
            default 36

        config BASE_GPIO_MMC_CMD
            int "MMC CMD"
            default 35
    endif

    config BASE_GPIO_BTN
        int "BTN pin"
        depends on BASE_BTN_INPUT
        range 0 48
        default 4 if IDF_TARGET_ESP32S3
        default 35

    config BASE_GPIO_INT
        int "INT pin"
        depends on BASE_GEXP_INT || BASE_USE_TSCN
        range 0 48
        default 21 if IDF_TARGET_ESP32S3
        default 34

    config BASE_GPIO_TPAD
        int "Touch pin"
        depends on BASE_USE_TPAD
        range 0 48
        default 2

    if BASE_USE_KNOB
        config BASE_GPIO_ENCA
            int "Knob ENCA"
            range 0 48
            default 15 if IDF_TARGET_ESP32S3
            default 37

        config BASE_GPIO_ENCB
            int "Knob ENCB"
            range 0 48
            default 16 if IDF_TARGET_ESP32S3
            default 38
    endif

    if BASE_USE_SERVO
        config BASE_GPIO_SERVOV
            int "PWM Servo Ver"
            range 0 48
            default 17 if IDF_TARGET_ESP32S3
            default 32

        config BASE_GPIO_SERVOH
            int "PWM Servo Hor"
            range 0 48
            default 18 if IDF_TARGET_ESP32S3
            default 33
    endif

    config BASE_GPIO_BUZZER
        int "PWM Buzzer"
        depends on BASE_USE_BUZZER
        range 0 48
        default 3 if IDF_TARGET_ESP32S3
        default 4

    if BASE_USE_I2S
        config BASE_GPIO_I2S_CLK
            int "I2S CLK"
            range 0 48
            default 39 if IDF_TARGET_ESP32S3
            default 9

        config BASE_GPIO_I2S_DAT
            int "I2S DAT"
            range 0 48
            default 40 if IDF_TARGET_ESP32S3
            default 10
    endif

    config BASE_CAM_PINS
        string
        default "32,-1,25,23,0,22,35,34,39,36,21,19,18,5" if BASE_BOARD_ATCAM
        default "-1,-1,25,23,21,22,35,34,39,36,19,18,5,4" if BASE_BOARD_WRCAM
        default "-1,-1,5,27,4,25,36,37,38,39,35,14,13,34" if BASE_BOARD_ESPEYE
        default "-1,15,22,26,27,21,19,36,18,39,5,34,35,32" if BASE_BOARD_M5TIMER
        default "-1,-1,1,2,3,39,18,15,38,40,42,46,45,41" if BASE_BOARD_S3ECAM
        default "38,-1,6,7,15,13,16,17,18,12,10,8,9,11" if BASE_BOARD_S3WRCAM
        help
            Camera PINs in order PWDN,RST,VSYNC,HREF,XCLK,PCLK,D7...D0

    config BASE_CAM_CUSTOM_PINS
        string "Camera pins" if BASE_USE_CAM && BASE_CAM_PINS=""
        help
            Camera PINs in order PWDN,RST,VSYNC,HREF,XCLK,PCLK,D7...D0

    config BASE_SCN_PINS
        string
        default "38,5,6,7,8,9,39,40,41,42,45,46,47,48" if BASE_BOARD_S3NL191
        help
            Screen PINs in order BL,RST,CS,DC,WR,RD,D0...SOC_LCD_I80_BUS_WIDTH

    config BASE_SCN_CUSTOM_PINS
        string "Screen pins" if BASE_SCN_I80 && BASE_SCN_PINS=""
        help
            Screen PINs in order BL,RST,CS,DC,WR,RD,D0...SOC_LCD_I80_BUS_WIDTH

    config BASE_ETH_PINS
        string
        default "9,10,11,12,13,14" if BASE_BOARD_S3ECAM
        help
            Ethernet PINs in order RST,INT,MOSI,MISO,SCLK/MDC,CS/MDIO

    config BASE_ETH_CUSTOM_PINS
        string "Ethernet pins" if BASE_USE_ETH && BASE_ETH_PINS=""
        help
            Ethernet PINs in order RST,INT,MOSI,MISO,SCLK/MDC,CS/MDIO

endmenu
```
