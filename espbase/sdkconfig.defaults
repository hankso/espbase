## espbase/sdkconfig.defaults
```kconfig
# Serial flasher config
CONFIG_ESPTOOLPY_FLASHSIZE_4MB=y

# Partition Table
CONFIG_PARTITION_TABLE_CUSTOM=y
CONFIG_PARTITION_TABLE_CUSTOM_FILENAME="partitions.csv"
CONFIG_PARTITION_TABLE_FILENAME="partitions.csv"

# HTTP Server
CONFIG_HTTPD_MAX_REQ_HDR_LEN=1024
CONFIG_MBEDTLS_DYNAMIC_BUFFER=y
CONFIG_ESP_HTTPS_SERVER_ENABLE=y

# Power Management
CONFIG_PM_ENABLE=y
CONFIG_PM_DFS_INIT_AUTO=y

# ESP System Settings
CONFIG_ESP_SYSTEM_EVENT_TASK_STACK_SIZE=4096
CONFIG_ESP_MAIN_TASK_STACK_SIZE=8192
CONFIG_ESP_MAIN_TASK_AFFINITY_NO_AFFINITY=y
CONFIG_ESP_TASK_WDT_CHECK_IDLE_TASK_CPU0=n
CONFIG_ESP_TASK_WDT_CHECK_IDLE_TASK_CPU1=n

# FreeRTOS
CONFIG_FREERTOS_HZ=1000
CONFIG_FREERTOS_USE_TICKLESS_IDLE=y

# Log -> Format
CONFIG_LOG_TIMESTAMP_SOURCE_SYSTEM=y

# LWIP
CONFIG_LWIP_LOCAL_HOSTNAME="espbase"
CONFIG_LWIP_MAX_SOCKETS=16
CONFIG_LWIP_SO_LINGER=y
CONFIG_LWIP_IP_FORWARD=y
CONFIG_LWIP_IPV4_NAPT=y
CONFIG_LWIP_IPV6_AUTOCONFIG=y
CONFIG_LWIP_IPV6_FORWARD=y
CONFIG_LWIP_DHCP_GET_NTP_SRV=y

# FAT Filesystem support
CONFIG_FATFS_LFN_HEAP=y

# SPIFFS Configuration
CONFIG_SPIFFS_OBJ_NAME_LEN=64

# LVGL configuration
CONFIG_LV_MEM_CUSTOM=y
CONFIG_LV_MEMCPY_MEMSET_STD=y
CONFIG_LV_FONT_MONTSERRAT_14=n
CONFIG_LV_FONT_DEFAULT_UNSCII_8=y
CONFIG_LV_USE_PNG=y
CONFIG_LV_USE_PERF_MONITOR=y
CONFIG_LV_USE_USER_DATA=y
CONFIG_LV_USE_FS_POSIX=y
CONFIG_LV_FS_POSIX_LETTER=83
CONFIG_LV_FS_POSIX_CACHE_SIZE=65535

# Espressif ELF Loader Configuration
CONFIG_ELF_FILE_SYSTEM_BASE_PATH=""
```
