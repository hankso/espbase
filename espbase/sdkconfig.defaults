## sdkconfig.defaults.camera
```kconfig
# ESP Base Configuration
CONFIG_BASE_USE_CAM=y

# Serial flasher config
CONFIG_ESPTOOLPY_FLASHFREQ_80M=y
CONFIG_ESPTOOLPY_FLASHMODE_QIO=y

# SPI RAM config
CONFIG_SPIRAM_MODE_OCT=y
CONFIG_SPIRAM_SPEED_80M=y

# Camera configurations
CONFIG_OV2640_SUPPORT=y
CONFIG_OV3660_SUPPORT=y
CONFIG_OV5640_SUPPORT=y
CONFIG_OV7725_SUPPORT=n
CONFIG_OV7670_SUPPORT=n
CONFIG_NT99141_SUPPORT=n
CONFIG_GC2145_SUPPORT=n
CONFIG_GC032A_SUPPORT=n
CONFIG_GC0308_SUPPORT=n
CONFIG_BF3005_SUPPORT=n
CONFIG_BF20A6_SUPPORT=n
CONFIG_SC101IOT_SUPPORT=n
CONFIG_SC030IOT_SUPPORT=n
CONFIG_SC031GS_SUPPORT=n
CONFIG_HM1055_SUPPORT=n
CONFIG_HM0360_SUPPORT=n
CONFIG_MEGA_CCM_SUPPORT=n
CONFIG_CAMERA_NO_AFFINITY=y
```

## sdkconfig.defaults.v5
```kconfig
# Chip-specific
CONFIG_ESP_DEFAULT_CPU_FREQ_MHZ_240=y

# Wi-Fi
CONFIG_ESP_WIFI_IRAM_OPT=n
CONFIG_ESP_WIFI_RX_IRAM_OPT=n

# TinyUSB
CONFIG_TINYUSB_HID_COUNT=1
CONFIG_TINYUSB_NET_MODE_NCM=y
```
