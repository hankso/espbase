## sdkconfig.defaults.flash16
```kconfig
# Serial flasher config
CONFIG_ESPTOOLPY_FLASHSIZE_16MB=y

# Partition_table
CONFIG_PARTITION_TABLE_CUSTOM_FILENAME="partitions-16m.csv"
CONFIG_PARTITION_TABLE_FILENAME="partitions-16m.csv"
```

## sdkconfig.defaults.flash8
```kconfig
# Serial flasher config
CONFIG_ESPTOOLPY_FLASHSIZE_8MB=y

# Partition_table
CONFIG_PARTITION_TABLE_CUSTOM_FILENAME="partitions-8m.csv"
CONFIG_PARTITION_TABLE_FILENAME="partitions-8m.csv"
```

## sdkconfig.defaults.release
```kconfig
CONFIG_LOG_DEFAULT_LEVEL_WARN=y
CONFIG_BOOTLOADER_LOG_LEVEL_WARN=y
CONFIG_COMPILER_OPTIMIZATION_SIZE=y
CONFIG_COMPILER_OPTIMIZATION_ASSERTIONS_SILENT=y
```

## sdkconfig.defaults.v4
```kconfig
# Chip-specific
CONFIG_ESP32_DEFAULT_CPU_FREQ_240=y
CONFIG_ESP32S3_DEFAULT_CPU_FREQ_240=y

# Wi-Fi
CONFIG_ESP32_WIFI_IRAM_OPT=n
CONFIG_ESP32_WIFI_RX_IRAM_OPT=n
```
